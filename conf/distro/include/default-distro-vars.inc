## conf/distro/include/default-distro-vars.inc
```bitbake
DISTRO_FEATURES = "${DISTRO_FEATURES_DEFAULT} ${DISTRO_FEATURES_LIBC} ${POKY_DEFAULT_DISTRO_FEATURES} pam sysvinit opengl wayland"
DISTRO_FEATURES_BACKFILL_CONSIDERED = "pulseaudio systemd"

LOCALE_UTF8_ONLY = "1"
IMAGE_LINGUAS = "en-us en-gb de-de fr-fr es-mx pt-br it-it"
#LIMIT_BUILT_LOCALES = "POSIX en_US en_GB de_DE fr_FR es_MX pt_BR it_IT"

COMMERCIAL_AUDIO_PLUGINS = "gst-plugins-ugly-mad gst-plugins-ugly-mpegaudioparse"
COMMERCIAL_VIDEO_PLUGINS = "gst-plugins-ugly-mpeg2dec gst-plugins-ugly-mpegstream gst-plugins-bad-mpegvideoparse"
```

## conf/distro/include/default-providers.inc
```bitbake
# most of these are set in rpi/machine/include/rpi-default-providers.inc
PREFERRED_PROVIDER_xserver_common = "x11-common"
```

## conf/distro/poky.conf
```bitbake
DISTRO_FEATURES_DEFAULT_append = " pam sysvinit opengl wayland"

DISTRO_FEATURES_BACKFILL_CONSIDERED = "pulseaudio systemd"
```

## conf/layer.conf
```bitbake
# We might have a conf and classes directory, append to BBPATH
BBPATH .= ":${LAYERDIR}"

# We have a recipes directory, add to BBFILES
BBFILES += "${LAYERDIR}/recipes*/*/*.bb \
            ${LAYERDIR}/recipes*/*/*.bbappend"

BBFILE_COLLECTIONS += "altdesktopextras"
BBFILE_PATTERN_altdesktopextras := "^${LAYERDIR}/"
BBFILE_PRIORITY_altdesktopextras = "5"

LAYERVERSION_altdesktopextras = "1"

LAYERDEPENDS_altdesktopextras = "core openembedded-layer"
LAYERSERIES_COMPAT_altdesktopextras = "sumo thud"
```
